#include <U8g2lib.h>
U8G2_SH1106_128X64_NONAME_F_HW_I2C u8g2(U8G2_R0);  // SCK=D1, SDA=D2
#include "DHT.h"
#include <ArduinoJson.h>
#include <ESP8266HTTPClient.h>
#include <WiFiClient.h>

#define DHT22Pin D5
#define DHTType DHT22

//////////////////////////////////////////////
//        RemoteXY include library          //
//////////////////////////////////////////////
#define REMOTEXY_MODE__WIFI
#include <ESP8266WiFi.h>

#define REMOTEXY_WIFI_SSID "neca"
#define REMOTEXY_WIFI_PASSWORD "nexxa2007"
#define REMOTEXY_SERVER_PORT 6377
#include <RemoteXY.h>

#pragma pack(push, 1)
uint8_t const PROGMEM RemoteXY_CONF_PROGMEM[] =
  { 255,0,0,11,0,112,0,19,0,0,0,0,31,1,106,200,1,1,8,0,
  68,5,15,98,50,1,8,36,129,17,2,73,12,64,1,84,101,109,112,101,
  114,97,116,117,114,101,0,68,4,87,99,47,1,8,6,129,26,73,52,12,
  64,6,72,117,109,105,100,105,116,121,0,129,19,174,67,12,64,24,76,117,
  102,116,113,117,97,108,105,116,195,164,116,0,70,9,148,18,18,16,26,1,
  0,70,42,148,18,18,16,26,135,0,70,75,148,18,18,16,26,94,0 };

struct {
  float onlineGraph_01_var1;
  float onlineGraph_02_var1;
  uint8_t led_red;
  uint8_t led_02;
  uint8_t led_03;
  uint8_t connect_flag;
} RemoteXY;
#pragma pack(pop)
/////////////////////////////////////////////
//         END RemoteXY include            //
/////////////////////////////////////////////

// ===== OPENWEATHERMAP SETTINGS =====
#define OWM_API_KEY   "b36b6058f848fdbdcbab04436059ad85"
#define OWM_CITY      "Innsbruck"
#define OWM_COUNTRY   "AT"
#define OWM_FETCH_INTERVAL  600000UL

// ===== FORECAST STORAGE =====
#define FORECAST_DAYS 3
struct ForecastDay {
  char label[4];    // e.g. "Mon"
  int  tMin;
  int  tMax;
  char weather[12]; // "Clear", "Rain", "Clouds", "Snow", "Drizzle", etc.
};
ForecastDay forecast[FORECAST_DAYS];
bool forecastReady = false;

const char* dowLabel(int dow) {
  const char* days[] = {"Sun","Mon","Tue","Wed","Thu","Fri","Sat"};
  return days[dow % 7];
}

// ===== DISPLAY SCREEN SWITCHING =====
#define SCREEN_INTERVAL 5000UL
uint8_t  currentScreen  = 0;
unsigned long lastScreenSwitch = 0;

// ===== DHT =====
DHT HT(DHT22Pin, DHTType);

// ===== BITMAPS =====
const PROGMEM uint BaudRate = 115200;

static const unsigned char image_Dehumidify_bits[] U8X8_PROGMEM = {
  0xf8,0xff,0x3f,0x00,0x04,0x00,0x40,0x00,0x02,0x00,0x80,0x00,
  0x01,0x00,0x00,0x01,0x01,0x00,0x00,0x01,0x01,0x10,0x00,0x01,
  0x01,0x10,0x00,0x01,0x01,0x18,0x00,0x01,0x01,0x38,0x00,0x01,
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  0x06,0x00,0xc0,0x00,0xfc,0xff,0x7f,0x00,0xf8,0xff,0x3f,0x00
};

static const unsigned char image_weather_temperature_bits[] U8X8_PROGMEM = {
  0x38,0x00,0x44,0x40,0xd4,0xa0,0x54,0x40,0xd4,0x1c,0x54,0x06,
  0xd4,0x02,0x54,0x02,0x54,0x06,0x92,0x1c,0x39,0x01,0x75,0x01,
  0x7d,0x01,0x39,0x01,0x82,0x00,0x7c,0x00
};

static const unsigned char image_Scanning_bits[] U8X8_PROGMEM = {
  0x00,0x00,0x00,0x00,0x00,0x00,0x00,0x00,0x00,0x00,0x00,0x00,0x00,0x00,0x00,0x00,
  0x00,0x00,0x00,0x00,0x00,0x00,0x00,0x00,0x00,0x00,0x00,0x00,0x00,0x00,0x00,0x00,
  0x00,0x00,0x00,0x00,0x00,0x00,0x00,0x00,0x00,0x00,0x00,0x00,0x00,0x00,0x00,0x00,
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  0x00,0xaa,0x00,0x00,0x00,0x1f,0x00,0x00,0x00,0x00,0x00,0x00,0x00,0x00,0x00,0x00,
  0x00
};

static const unsigned char image_RFIDDolphinSend_bits[] U8X8_PROGMEM = {0x00,0x00,
0xfe,0x1f,0x00,0x00,0x00,0x40,0x00,0x00,0x00,0x00,0x00,0x00,0xc0,0x01,0xe0,0x01,0x00,0x00,0x80,0x00,0x00,0x00,0x00,0x00,0x00,0x30,0x00,0x00,0x06,0x00
,0x00,0x80,0x00,0x00,0x00,0x00,0x00,0x00,0x0c,0x00,0x00,0x18,0x00,0x00,0x00,0x01,0x00,0x00,0x00,0x00,0x00,0x02,0x00,0x00,0x20,0x00,0x00,0x01,0x01,0x00,0xa0
,0x0a,0x00,0x00,0x01,0x00,0x00,0x40,0x00,0x00,0x02,0x02,0x00,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0x01,
0x00,0x04,0x02,0x00,0x08,0x20,0x00,0x20,0x00,0x00,0x00,0x00,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0x10,
0x00,0x00,0x00,0x42,0x04,0x20,0x08,0x04,0x00,0x14,0x40,0x00,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0x04,
0x00,0x14,0x50,0x00,0x08,0x09,0x08,0x80,0x24,0x09,0x20,0x08,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0x80,
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0x00,0x00,0x00,0x00,0x00,0x00,0x00,0x08,0x02,0x00,0x00,0x00,0x00,0x00,0x00,0x00};

// ===== WEATHER ICONS 16x16 XBM =====
// ---- Sun (Clear) ----
static const unsigned char icon_sun_bits[] U8X8_PROGMEM = {
  0x40,0x00,0x40,0x00,0x42,0x10,0x24,0x12,0x18,0x06,0xf8,0x07,
  0x0c,0x18,0x04,0x10,0x0c,0x18,0xf8,0x07,0x18,0x06,0x24,0x12,
  0x42,0x10,0x40,0x00,0x40,0x00,0x00,0x00
};

// ---- Cloud (Clouds) ----
static const unsigned char icon_cloud_bits[] U8X8_PROGMEM = {
  0x00,0x00,0x00,0x00,0x80,0x03,0x60,0x04,0x18,0x04,0x04,0x08,
  0x02,0x08,0xfe,0x1f,0x02,0x20,0x02,0x20,0xfe,0x1f,0x00,0x00,
  0x00,0x00,0x00,0x00,0x00,0x00,0x00,0x00
};

// ---- Rain ----
static const unsigned char icon_rain_bits[] U8X8_PROGMEM = {
  0x00,0x00,0x80,0x03,0x60,0x04,0x18,0x04,0x04,0x08,0x02,0x08,
  0xfe,0x1f,0x02,0x20,0xfe,0x1f,0x44,0x04,0xaa,0x0a,0x44,0x04,
  0x00,0x00,0x00,0x00,0x00,0x00,0x00,0x00
};


static const unsigned char image_weather_sun_bits[] U8X8_PROGMEM = {0x80,0x00,0x84,0x10,0x08,0x08,0xc0,0x01,0x31,0x46,0x12,0x24,
0x08,0x08,0x08,0x08,0x08,0x08,0x12,0x24,0x31,0x46,0xc0,0x01,0x08,0x08,0x84,0x10,0x80,0x00,0x00,0x00};


static const unsigned char image_weather_cloud_rain_bits[] U8X8_PROGMEM = {0x00,0x00,0x00,0xe0,0x03,0x00,0x10,0x04,0x00,0x08,0x08,
0x00,0x0c,0x10,0x00,0x02,0x70,0x00,0x01,0x80,0x00,0x01,0x00,0x01,0x02,0x00,0x01,0xfc,0xff,0x00,0x80,0x08,0x00,0x44,0x44,0x00,0x22,
0x21,0x00,0x89,0x14,0x00,0x44,0x02,0x00,0x00,0x01,0x00};

static const unsigned char image_weather_cloud_sunny_bits[] U8X8_PROGMEM = {0x00,0x04,0x00,0x40,0x40,0x00,0x00,0x0e,0x00,0x80,0x31,
0x00,0x90,0x20,0x01,0x40,0x40,0x00,0x40,0x40,0x00,0xe0,0x41,0x00,0x10,0x22,0x01,0x08,0x34,0x00,0x0c,0x0c,0x00,0x06,0x78,0x00,0x01,
0xc0,0x00,0x01,0x80,0x00,0x01,0x80,0x00,0xfe,0x7f,0x00};

// ===== GRAPH SETTINGS =====
#define GRAPH_W 128
#define GRAPH_H 22
#define GRAPH_Y 42
int graphTemp[GRAPH_W] = { 0 };

float minTemp = 15.0;
float maxTemp = 50.0;

// ===== LED PINS =====
#define PIN_LED_Y D8
#define PIN_LED_G D7
#define PIN_LED_R D6

// ===== TIMERS =====
unsigned long lastRead  = 0;
unsigned long lastFetch = 0;
#define READ_INTERVAL 1000

// =====================================================
//   LUFTQUALITÄT
// =====================================================
void luftquali(float tempC, float humid) {
  if (tempC > 18 && tempC < 24 && humid > 35 && humid < 60) {
    digitalWrite(PIN_LED_G, HIGH); digitalWrite(PIN_LED_R, LOW); digitalWrite(PIN_LED_Y, LOW);
    RemoteXY.led_02 = 1; RemoteXY.led_03 = 0; RemoteXY.led_red = 0;
  } else if (tempC > 24 && tempC < 32 && humid > 20 && humid < 35) {
    digitalWrite(PIN_LED_G, LOW); digitalWrite(PIN_LED_R, LOW); digitalWrite(PIN_LED_Y, HIGH);
    RemoteXY.led_02 = 0; RemoteXY.led_03 = 1; RemoteXY.led_red = 0;
  } else {
    digitalWrite(PIN_LED_G, LOW); digitalWrite(PIN_LED_R, HIGH); digitalWrite(PIN_LED_Y, LOW);
    RemoteXY.led_02 = 0; RemoteXY.led_03 = 0; RemoteXY.led_red = 1;
  }
}

// =====================================================
//   REMOTE XY GRAPH
// =====================================================
void onlineGraph(float tempC, float humid) {
  RemoteXY.onlineGraph_01_var1 = tempC;
  RemoteXY.onlineGraph_02_var1 = humid;
}

// =====================================================
//   LOCAL OLED GRAPH
// =====================================================
void addDataPoint(float tempC) {
  for (int i = 0; i < GRAPH_W - 1; i++) graphTemp[i] = graphTemp[i + 1];
  int mapped = (int)map((long)(tempC * 10), (long)(minTemp * 10), (long)(maxTemp * 10), 0, GRAPH_H - 1);
  graphTemp[GRAPH_W - 1] = constrain(mapped, 0, GRAPH_H - 1);
}

void drawGraph() {
  u8g2.drawFrame(0, GRAPH_Y - 1, GRAPH_W, GRAPH_H + 2);
  for (int x = 1; x < GRAPH_W - 2; x++) {
    int y1 = (GRAPH_Y + GRAPH_H - 1) - graphTemp[x - 1];
    int y2 = (GRAPH_Y + GRAPH_H - 1) - graphTemp[x];
    u8g2.drawLine(x, y1, x + 1, y2);
  }
}

// =====================================================
//   DRAW WEATHER ICON  16x16 at (x, y)
// =====================================================
void drawWeatherIcon(int x, int y, const char* weather) {
  if (strcmp(weather, "Clear") == 0) {
    u8g2.drawXBM(x, y, 16, 16, image_weather_sun_bits);
  } else if (strcmp(weather, "Rain") == 0 || strcmp(weather, "Drizzle") == 0 || strcmp(weather, "Thunderstorm") == 0) {
    u8g2.drawXBM(x, y, 24, 16, image_weather_cloud_rain_bits);
  } else if (strcmp(weather, "Clouds") == 0 || strcmp(weather, "Mist") == 0 || strcmp(weather, "Fog") == 0) {
    u8g2.drawXBM(x, y, 24, 16, image_weather_cloud_sunny_bits);
  } else {
    // fallback: draw a simple question mark box
    u8g2.drawFrame(x, y, 16, 16);
    u8g2.drawStr(x + 5, y + 12, "?");
  }
}

// =====================================================
//   OPENWEATHERMAP FETCH
// =====================================================
void fetchForecast() {
  if (WiFi.status() != WL_CONNECTED) return;

  WiFiClient client;
  HTTPClient http;

  String url = "http://api.openweathermap.org/data/2.5/forecast"
               "?q=" + String(OWM_CITY) + "," + String(OWM_COUNTRY) +
               "&appid=" + String(OWM_API_KEY) +
               "&units=metric&cnt=24";

  Serial.print("WiFi status: ");
  Serial.println(WiFi.status());
  Serial.print("Fetching: ");
  Serial.println(url);

  http.begin(client, url);
  int httpCode = http.GET();

  Serial.print("HTTP code: ");
  Serial.println(httpCode);

  if (httpCode == HTTP_CODE_OK) {
    String payload = http.getString();
    Serial.print("Payload length: ");
    Serial.println(payload.length());

    DynamicJsonDocument filter(512);
    filter["list"][0]["dt"] = true;
    filter["list"][0]["main"]["temp_min"] = true;
    filter["list"][0]["main"]["temp_max"] = true;
    filter["list"][0]["weather"][0]["main"] = true;  // <-- weather condition

    DynamicJsonDocument doc(8192);
    DeserializationError err = deserializeJson(doc, payload,
                                DeserializationOption::Filter(filter));
    Serial.print("JSON parse result: ");
    Serial.println(err.c_str());

    if (!err) {
      float dayMin[FORECAST_DAYS];
      float dayMax[FORECAST_DAYS];
      long  dayDt [FORECAST_DAYS];
      char  dayWx [FORECAST_DAYS][12];
      int   dayCount = 0;

      for (int i = 0; i < FORECAST_DAYS; i++) {
        dayMin[i] = 999; dayMax[i] = -999; dayDt[i] = 0;
        strcpy(dayWx[i], "?");
      }

      JsonArray list = doc["list"].as<JsonArray>();
      for (JsonObject entry : list) {
        long  dt   = entry["dt"].as<long>();
        float tMin = entry["main"]["temp_min"].as<float>();
        float tMax = entry["main"]["temp_max"].as<float>();
        const char* wx = entry["weather"][0]["main"] | "?";

        long dayIdx = (dt / 86400L);

        int slot = -1;
        for (int d = 0; d < dayCount; d++) {
          if ((dayDt[d] / 86400L) == dayIdx) { slot = d; break; }
        }
        if (slot == -1 && dayCount < FORECAST_DAYS) {
          slot = dayCount++;
          dayDt[slot] = dt;
          dayMin[slot] = tMin;
          dayMax[slot] = tMax;
          strncpy(dayWx[slot], wx, 11);
          dayWx[slot][11] = '\0';
        } else if (slot != -1) {
          if (tMin < dayMin[slot]) dayMin[slot] = tMin;
          if (tMax > dayMax[slot]) dayMax[slot] = tMax;
        }
      }

      int startSlot = 0;
      for (int d = 0; d < FORECAST_DAYS && (d + startSlot) < dayCount; d++) {
        int s = d + startSlot;
        int dow = (int)((dayDt[s] / 86400L + 4) % 7);
        strncpy(forecast[d].label, dowLabel(dow), 3);
        forecast[d].label[3] = '\0';
        forecast[d].tMin = (int)dayMin[s];
        forecast[d].tMax = (int)dayMax[s];
        strncpy(forecast[d].weather, dayWx[s], 11);
        forecast[d].weather[11] = '\0';
        Serial.print(forecast[d].label);
        Serial.print(" ");
        Serial.print(forecast[d].tMin);
        Serial.print("/");
        Serial.print(forecast[d].tMax);
        Serial.print(" ");
        Serial.println(forecast[d].weather);
      }
      forecastReady = true;
      Serial.println("Forecast fetched OK");
    } else {
      Serial.print("JSON error: "); Serial.println(err.c_str());
    }
  } else {
    Serial.print("HTTP error: "); Serial.println(httpCode);
  }
  http.end();
}

// =====================================================
//   DRAW SCREEN 0  –  Local DHT22 data
// =====================================================
void drawScreenLocal(float tempC, float humid) {
  u8g2.setFont(u8g2_font_8x13B_tf);
  u8g2.setCursor(22, 22);
  u8g2.print(tempC, 1);
  u8g2.drawStr(56, 22, "C");
  u8g2.setCursor(92, 22);
  u8g2.print(humid, 1);

  u8g2.setFontMode(1);
  u8g2.setBitmapMode(1);
  u8g2.drawFrame(0,  0, 65, 29);
  u8g2.drawFrame(64, 0, 63, 29);
  u8g2.drawXBM(2,  7, 16, 16, image_weather_temperature_bits);

  u8g2.setDrawColor(2);
  u8g2.setFont(u8g2_font_6x10_tr);
  u8g2.drawStr(1, 38, "Temperature:");

  u8g2.setDrawColor(1);
  u8g2.drawXBM(64, 1, 25, 27, image_Dehumidify_bits);

  drawGraph();
}

// =====================================================
//   DRAW SCREEN 1  –  3-day forecast
//   Layout per row:  [Icon 16x16] [Day] [vMin] [^Max]
//   Row height: 18px to fit icon
// =====================================================
void drawScreenForecast() {
  u8g2.setFont(u8g2_font_6x10_tr);
  u8g2.setDrawColor(1);

  u8g2.drawStr(22, 10, "3-Day Forecast");
  u8g2.drawHLine(0, 12, 128);

  if (!forecastReady) {
    u8g2.setFontMode(1);
    u8g2.setBitmapMode(1);
    u8g2.drawXBMP(0, 12, 97, 61, image_RFIDDolphinSend_bits);
    u8g2.setFont(u8g2_font_6x10_tr);
    u8g2.drawStr(50, 53, "Fetching...");
    return;
  }

  // 3 rows starting at y=14, each row is 17px tall
  // Columns: icon(0), day label(20), min temp(68), max temp(100)
  for (int d = 0; d < FORECAST_DAYS; d++) {
    int y = 14 + d * 17;   // top of icon row
    int yText = y + 12;    // text baseline (inside the 16px icon height)
    char buf[8];

    // Weather icon (16x16)
    drawWeatherIcon(0, y, forecast[d].weather);

    // Day label
    u8g2.setFont(u8g2_font_6x10_tr);
    u8g2.drawStr(20, yText, forecast[d].label);

    // Min temp
    snprintf(buf, sizeof(buf), "%d", forecast[d].tMin);
    u8g2.drawStr(68, yText, buf);

    // Max temp
    snprintf(buf, sizeof(buf), "%d", forecast[d].tMax);
    u8g2.drawStr(100, yText, buf);
  }

}

// =====================================================
//   SETUP
// =====================================================
void setup() {
  Serial.begin(115200);
  delay(500);
  Serial.println("\n\n=== BOOT ===");

  u8g2.begin();
  RemoteXY_Init();

  // Loading screen
  u8g2.clearBuffer();
  u8g2.setFontMode(1);
  u8g2.setBitmapMode(1);
  u8g2.drawXBMP(2, 6, 123, 52, image_Scanning_bits);
  u8g2.sendBuffer();
  delay(2000);

  pinMode(PIN_LED_R, OUTPUT);
  pinMode(PIN_LED_G, OUTPUT);
  pinMode(PIN_LED_Y, OUTPUT);

  HT.begin();

  // Wait for WiFi
  Serial.print("Waiting for WiFi...");
  unsigned long wifiWait = millis();
  while (WiFi.status() != WL_CONNECTED && millis() - wifiWait < 10000) {
    delay(500);
    Serial.print(".");
  }
  Serial.println();

  if (WiFi.status() == WL_CONNECTED) {
    Serial.println("WiFi ready, fetching forecast...");
    delay(500);
    fetchForecast();
  } else {
    Serial.println("WiFi not connected, skipping first fetch.");
  }
  lastFetch = millis();
}

// =====================================================
//   LOOP
// =====================================================
void loop() {
  RemoteXYEngine.handler();

  float tempC = HT.readTemperature();
  float humid = HT.readHumidity();

  luftquali(tempC, humid);
  onlineGraph(tempC, humid);

  if (millis() - lastRead >= READ_INTERVAL) {
    lastRead = millis();
    if (!isnan(tempC)) addDataPoint(tempC);
  }

  if (millis() - lastFetch >= OWM_FETCH_INTERVAL) {
    lastFetch = millis();
    fetchForecast();
  }

  if (millis() - lastScreenSwitch >= SCREEN_INTERVAL) {
    lastScreenSwitch = millis();
    currentScreen = (currentScreen + 1) % 2;
  }

  u8g2.firstPage();
  do {
    if (currentScreen == 0) {
      drawScreenLocal(tempC, humid);
    } else {
      drawScreenForecast();
    }
  } while (u8g2.nextPage());
}
